## cc/boards/arm/capsoid/Kconfig
```kconfig
if BOARD_CAPSOID

config GPIO_AS_PINRESET
	bool "GPIO as pin reset (reset button)"
	default y

endif
```

## cc/boards/arm/capsoid/Kconfig.board
```kconfig
config BOARD_CAPSOID
	bool "CAPSOID"
	select HAS_DTS_GPIO
	depends on SOC_STM32F103X8
```
